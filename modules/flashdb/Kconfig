## modules/flashdb/Kconfig
```kconfig
# Copyright (c) 2024 Linumiz
# SPDX-License-Identifier: Apache-2.0

config ZEPHYR_FLASHDB_MODULE
	bool

config FLASHDB
	bool "Flashdb Database"
	depends on POSIX_FILE_SYSTEM
	depends on POSIX_THREADS
	help
	 This option enables flashdb database support.

if FLASHDB

config FLASHDB_TIMESERIES
	bool "Flashdb Time series"
	help
	 This option enables flashdb time series mode.

config FLASHDB_KEYVALUE
	bool "Flashdb Key value"
	help
	 This option enables flashdb key value mode.

config FLASHDB_DEBUG_ENABLE
	bool "Enable Flashdb debug"
	help
	 This option enables flashdb debug message.
endif
```

## west.yml
```yaml
# Copyright (c) Linumiz 2024

manifest:

  remotes:
    - name: rixx
      url-base: https://github.com/linumiz

    - name: zephyr
      url-base: https://github.com/zephyrproject-rtos

    - name: flashDB
      url-base: https://github.com/armink

  projects:
# zephyr
    - name: zephyr
      remote: zephyr
      revision: main
      path: zephyr
      import: true

# rixx sdk modules
    # FlashDB
    - name: FlashDB
      remote: flashDB
      revision: 523fd2052d13baf72fd1d8e177c2a162a03392be
      path: modules/lib/flashdb

   #json-c
    - name: json-c
      remote: rixx
      revision: dev/zephyr
      path: modules/lib/json-c
```
